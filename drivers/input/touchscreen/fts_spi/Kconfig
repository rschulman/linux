## drivers/input/touchscreen/fts_spi/Kconfig
```kconfig
config TOUCHSCREEN_ST_FTS_V521_SPI
	tristate "ST FTS V521 SPI Touchscreen"
	depends on SPI
	help
	  Say Y here if you have ST FTS series SPI touchscreen.

	  If unsure, say N.

	  To compile this driver as a module, choose M here.
```
